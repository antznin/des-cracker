/*
 * CAUTION: This file is automatically generated by Xilinx.
 * Version: HSI 2018.3
 * Today is: Wed Jun  5 16:36:25 2019
 */


/ {
	amba_pl: amba_pl {
		#address-cells = <1>;
		#size-cells = <1>;
		compatible = "simple-bus";
		ranges ;
		axi: axi@40000000 {
			/* This is a place holder node for a custom IP, user may need to update the entries */
			clock-names = "aclk";
			clocks = <&clkc 15>;
			compatible = "xlnx,axi-1.0";
			interrupt-names = "irq";
			interrupt-parent = <&intc>;
			interrupts = <0 29 1>;
			reg = <0x40000000 0x1000>;
		};
	};
};
