/*
 * CAUTION: This file is automatically generated by Xilinx.
 * Version: HSI 2018.3
 * Today is: Wed Jun  5 16:36:25 2019
 */


/dts-v1/;
#include "zynq-7000.dtsi"
#include "pl.dtsi"
#include "pcw.dtsi"
/ {
	chosen {
		bootargs = "earlycon uio_pdrv_genirq.of_id=xlnx,axi-1.0";
	};
	aliases {
	};
	memory {
		device_type = "memory";
		reg = <0x0 0x20000000>;
	};
};
